## config/boards/shields/ya36/Kconfig.defconfig
```kconfig
if SHIELD_YA36_LEFT

config ZMK_KEYBOARD_NAME
  default "YA36 Left"

config ZMK_SPLIT_BLE_ROLE_CENTRAL
  default y

endif

if SHIELD_YA36_LEFT || SHIELD_YA36_RIGHT

config ZMK_SPLIT
  default y

endif
```

## config/boards/shields/ya36/Kconfig.shield
```kconfig
config SHIELD_YA36_LEFT
    def_bool $(shields_list_contains,ya36_left)

config SHIELD_YA36_RIGHT
    def_bool $(shields_list_contains,ya36_right)
```
