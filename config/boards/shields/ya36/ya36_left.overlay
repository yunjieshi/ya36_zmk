#include "ya36.dtsi"

&kscan0 {
  col-gpios
    = <&pro_micro 2 GPIO_ACTIVE_HIGH>
    , <&pro_micro 1 GPIO_ACTIVE_HIGH>
    , <&pro_micro 0 GPIO_ACTIVE_HIGH>
    , <&pro_micro 15 GPIO_ACTIVE_HIGH>
    , <&pro_micro 14 GPIO_ACTIVE_HIGH>
    ;
};
